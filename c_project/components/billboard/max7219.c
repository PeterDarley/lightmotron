#include "max7219.h"
#include "esp_log.h"
#include "driver/gpio.h"

#include <string.h>
#include <stdlib.h>

static const char *TAG = "max7219";

/* MAX7219 registers */
#define REG_NOOP        0x00
#define REG_DIGIT0      0x01
#define REG_DECODE_MODE 0x09
#define REG_INTENSITY   0x0A
#define REG_SCAN_LIMIT  0x0B
#define REG_SHUTDOWN    0x0C
#define REG_DISPLAY_TEST 0x0F

/* Basic 8x8 font for ASCII 32-126 (each char is 8 bytes, column-major) */
static const uint8_t font_8x8[][8] = {
    {0x00,0x00,0x00,0x00,0x00,0x00,0x00,0x00}, /* space */
    {0x00,0x00,0x5F,0x00,0x00,0x00,0x00,0x00}, /* ! */
    {0x00,0x07,0x00,0x07,0x00,0x00,0x00,0x00}, /* " */
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    {0x10,0x08,0x08,0x10,0x08,0x00,0x00,0x00}, /* ~ */
};

#define FONT_FIRST_CHAR 32
#define FONT_LAST_CHAR  126
#define FONT_CHAR_WIDTH 8

static esp_err_t send_to_all(max7219_t *dev, uint8_t reg, uint8_t data)
{
    /* Send same register/data pair to all modules in chain */
    int buf_len = dev->num_modules * 2;
    uint8_t *tx_buf = calloc(buf_len, 1);
    if (!tx_buf) return ESP_ERR_NO_MEM;

    for (int i = 0; i < dev->num_modules; i++) {
        tx_buf[i * 2] = reg;
        tx_buf[i * 2 + 1] = data;
    }

    spi_transaction_t trans = {
        .length = buf_len * 8,
        .tx_buffer = tx_buf,
    };

    gpio_set_level(dev->cs_pin, 0);
    esp_err_t ret = spi_device_transmit(dev->spi, &trans);
    gpio_set_level(dev->cs_pin, 1);

    free(tx_buf);
    return ret;
}

esp_err_t max7219_init(max7219_t *dev, int mosi_pin, int sck_pin, int cs_pin, int num_modules)
{
    if (!dev || num_modules < 1) return ESP_ERR_INVALID_ARG;

    dev->num_modules = num_modules;
    dev->cs_pin = cs_pin;
    dev->initialized = false;

    /* Allocate framebuffer */
    dev->framebuffer = calloc(num_modules * 8, 1);
    if (!dev->framebuffer) return ESP_ERR_NO_MEM;

    /* Configure CS pin */
    gpio_config_t io_conf = {
        .pin_bit_mask = (1ULL << cs_pin),
        .mode = GPIO_MODE_OUTPUT,
        .pull_up_en = GPIO_PULLUP_DISABLE,
        .pull_down_en = GPIO_PULLDOWN_DISABLE,
        .intr_type = GPIO_INTR_DISABLE,
    };
    gpio_config(&io_conf);
    gpio_set_level(cs_pin, 1);

    /* Configure SPI */
    spi_bus_config_t bus_cfg = {
        .mosi_io_num = mosi_pin,
        .miso_io_num = -1,
        .sclk_io_num = sck_pin,
        .quadwp_io_num = -1,
        .quadhd_io_num = -1,
        .max_transfer_sz = num_modules * 2,
    };

    esp_err_t ret = spi_bus_initialize(SPI2_HOST, &bus_cfg, SPI_DMA_DISABLED);
    if (ret != ESP_OK) {
        ESP_LOGE(TAG, "SPI bus init failed: %s", esp_err_to_name(ret));
        return ret;
    }

    spi_device_interface_config_t dev_cfg = {
        .clock_speed_hz = 10 * 1000 * 1000, /* 10 MHz */
        /* Mode 2 (CPOL=1, CPHA=0) -- matches MicroPython's
         * SPI(1, polarity=1, phase=0, ...) in lib/billboard.py. */
        .mode = 2,
        .spics_io_num = -1, /* Manual CS */
        .queue_size = 1,
    };

    ret = spi_bus_add_device(SPI2_HOST, &dev_cfg, &dev->spi);
    if (ret != ESP_OK) {
        ESP_LOGE(TAG, "SPI device add failed");
        return ret;
    }

    /* Initialize MAX7219 registers. Order matches Matrix8x8._init_display()
     * in lib/max7219.py: enter shutdown first to configure safely, then
     * configure the rest, then leave shutdown last. */
    send_to_all(dev, REG_SHUTDOWN, 0x00);    /* enter shutdown to configure safely */
    send_to_all(dev, REG_DISPLAY_TEST, 0x00); /* disable test mode */
    send_to_all(dev, REG_SCAN_LIMIT, 0x07);   /* scan all 8 rows */
    send_to_all(dev, REG_DECODE_MODE, 0x00);  /* raw LED control (no BCD decode) */
    send_to_all(dev, REG_INTENSITY, 0x05);    /* medium brightness */
    send_to_all(dev, REG_SHUTDOWN, 0x01);     /* normal operation */

    /* Mark initialized before clearing: max7219_show() (called by
     * max7219_clear()) no-ops on an uninitialized device, which would
     * otherwise leave the display showing power-on garbage until the
     * first real draw. Matches Matrix8x8.__init__ unconditionally calling
     * self.fill(0); self.show() in lib/max7219.py. */
    dev->initialized = true;
    max7219_clear(dev);

    ESP_LOGI(TAG, "MAX7219 initialized: %d modules", num_modules);
    return ESP_OK;
}

esp_err_t max7219_set_brightness(max7219_t *dev, int brightness)
{
    if (!dev || !dev->initialized) return ESP_ERR_INVALID_STATE;
    if (brightness < 0) brightness = 0;
    if (brightness > 15) brightness = 15;

    return send_to_all(dev, REG_INTENSITY, (uint8_t)brightness);
}

void max7219_clear(max7219_t *dev)
{
    if (!dev) return;

    memset(dev->framebuffer, 0, dev->num_modules * 8);
    max7219_show(dev);
}

void max7219_set_pixel(max7219_t *dev, int x, int y, int val)
{
    if (!dev || x < 0 || y < 0 || y >= 8) return;

    int total_width = dev->num_modules * 8;
    if (x >= total_width) return;

    /* Determine which module and column within that module */
    int module = x / 8;
    int col = x % 8;
    int byte_idx = module * 8 + y;

    if (val) {
        dev->framebuffer[byte_idx] |= (1 << (7 - col));
    } else {
        dev->framebuffer[byte_idx] &= ~(1 << (7 - col));
    }
}

esp_err_t max7219_show(max7219_t *dev)
{
    if (!dev || !dev->initialized) return ESP_ERR_INVALID_STATE;

    /* Send row by row — MAX7219 digit registers are row-based */
    int buf_len = dev->num_modules * 2;
    uint8_t tx_buf[16]; /* Max 8 modules × 2 bytes */
    if (buf_len > (int)sizeof(tx_buf)) buf_len = sizeof(tx_buf);

    for (int row = 0; row < 8; row++) {
        memset(tx_buf, 0, buf_len);

        for (int mod = 0; mod < dev->num_modules; mod++) {
            /* Send module 0's data first, like Matrix8x8.show() in
             * lib/max7219.py. In a daisy chain, data sent first shifts
             * furthest down the chain, so module 0 ends up in the
             * far/left-most physical chip and module (num-1) in the
             * near/right-most chip nearest the MCU -- getting this order
             * backwards mirrors the display across modules. */
            tx_buf[mod * 2] = REG_DIGIT0 + row;
            tx_buf[mod * 2 + 1] = dev->framebuffer[mod * 8 + row];
        }

        spi_transaction_t trans = {
            .length = buf_len * 8,
            .tx_buffer = tx_buf,
        };

        gpio_set_level(dev->cs_pin, 0);
        esp_err_t ret = spi_device_transmit(dev->spi, &trans);
        gpio_set_level(dev->cs_pin, 1);

        if (ret != ESP_OK) return ret;
    }

    return ESP_OK;
}

void max7219_fill(max7219_t *dev, const uint8_t *data, int len)
{
    if (!dev || !data) return;

    int max_len = dev->num_modules * 8;
    if (len > max_len) len = max_len;

    memcpy(dev->framebuffer, data, len);
}

void max7219_draw_char(max7219_t *dev, char c, int x, int y)
{
    if (!dev) return;
    if (c < FONT_FIRST_CHAR || c > FONT_LAST_CHAR) return;

    const uint8_t *glyph = font_8x8[c - FONT_FIRST_CHAR];

    for (int col = 0; col < FONT_CHAR_WIDTH; col++) {
        uint8_t column_data = glyph[col];
        for (int row = 0; row < 8; row++) {
            if (column_data & (1 << row)) {
                max7219_set_pixel(dev, x + col, y + row, 1);
            }
        }
    }
}

void max7219_draw_text(max7219_t *dev, const char *text, int x, int y)
{
    if (!dev || !text) return;

    int cursor_x = x;
    while (*text) {
        max7219_draw_char(dev, *text, cursor_x, y);
        cursor_x += FONT_CHAR_WIDTH;
        text++;
    }
}
